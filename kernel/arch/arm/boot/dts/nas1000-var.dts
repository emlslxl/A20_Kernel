/dts-v1/;

/ {
	model = "NAS1000";
	compatible = "allwinner,sun7i";
	#address-cells = <1>;
	#size-cells = <1>;

	memory {
		device_type = "memory";
		reg = <0x40000000 0x40000000>;
	};

	chosen {
		name = "chosen";
		bootargs = "console=ttyS0,115200n8 mtdparts=mtd-nand-sunxi.0:<mtdparts> root=/dev/sda1 rw rootfstype=ext4 rootwait lpj=9576448 splash=0x43100000,0x100000";
	};
};
