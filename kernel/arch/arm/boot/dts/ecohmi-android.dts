/dts-v1/;

/ {
	model = "ECOHMI";
	compatible = "allwinner,sunxi";
	#address-cells = <1>;
	#size-cells = <1>;

	memory {
		device_type = "memory";
		reg = <0x40000000 0x20000000>;
	};

	chosen {
		name = "chosen";
		bootargs = "console=ttyS0,115200n8 init=/init mtdparts=mtd-nand-sunxi.0:14M@0xb00000(head),256M(root),-(data) ubi.mtd=1 ubi.mtd=2 root=ubi0:rootfs rw rootfstype=ubifs quiet lpj=5009408 splash=0x43100000,0x100000";
	};
};
